// redo: dtparam -D -d ../firmware-master/boot/overlays i2c=on

/dts-v1/;

/ {
        compatible = "raspberrypi,4-model-b";

        fragment-1 {
                target = <0x47>;

                __overlay__ {
                        status = "okay";
                };
        };

        fragment-0 {
                target = <0x32>;

                __overlay__ {
                        status = "okay";
                };
        };
};
